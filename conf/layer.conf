## conf/layer.conf
```bitbake
# We have a conf and classes directory, add to BBPATH
BBPATH .= ":${LAYERDIR}"

# We have recipes-* directories, add to BBFILES
BBFILES += "${LAYERDIR}/recipes-*/*/*.bb \
            ${LAYERDIR}/recipes-*/*/*.bbappend"

BBFILE_COLLECTIONS += "meta-handheld-one"
BBFILE_PATTERN_meta-handheld-one = "^${LAYERDIR}/"
BBFILE_PRIORITY_meta-handheld-one = "6"

LAYERDEPENDS_meta-handheld-one = "core"
LAYERSERIES_COMPAT_meta-handheld-one = "scarthgap"
```

## conf/machine/include/am62x-handheld.inc
```bitbake
# Graphics configuration for AM62x handheld
DISTRO_FEATURES:append = " opengl egl retroarch-gles"
```

## conf/machine/phyboard-handheld-am62pxx-1.conf
```bitbake
#@TYPE: Machine
#@NAME: phyboard-handheld-am62pxx-1
#@DESCRIPTION: PHYTEC phyBOARD Handheld AM62Px, HS-FS
#@ARTICLENUMBERS: PCM-081.A0

require conf/machine/include/phyam62pxx.inc

MACHINEOVERRIDES =. ":phyboard-lynx:"

MACHINE_FEATURES:append = " gaming emmc gpu wifi bluetooth"

DISTRO_FEATURES:append = " retroarch-gles retroarch-opengl"

KERNEL_DEVICETREE = " \
    ti/k3-am62p5-phyboard-lynx.dtb \
    ${KERNEL_OVERLAYS} \
"

UBOOT_MACHINE = "phycore_am62px_a53_defconfig"
```

## conf/machine/phyboard-lyra-handheld-am62xx-3-k3r5.conf
```bitbake
require conf/machine/phyboard-lyra-am62xx-3-k3r5.conf

BBMASK += "meta-handheld-one/recipes-kernel/linux/linux-phytec-ti_6.12.35"
```

## conf/machine/phyboard-lyra-handheld-am62xx-3.conf
```bitbake
#@TYPE: Machine
#@NAME: phyboard-lyra-handheld-am62xx-3
#@DESCRIPTION: PHYTEC phyBOARD-Lyra AM62x, 1-4 GB RAM, HS-FS
#@ARTICLENUMBERS: KPB-07124-002.A0, PCM-071-5432DE11I.A0, PCM-071-3231BX11I.A0

require conf/machine/phyboard-lyra-am62xx-3.conf
require conf/machine/include/am62x-handheld.inc

BBMASK += "meta-handheld-one/recipes-kernel/linux/linux-phytec-ti_6.12.35"

MACHINE_FEATURES:append = " gaming"

DISTRO_FEATURES:append = " retroarch-gles"

DISTRO_FEATURES:remove = " vulkan"
```
